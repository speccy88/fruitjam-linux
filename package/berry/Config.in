## package/berry/Config.in
```kconfig
config BR2_PACKAGE_BERRY
	bool "berry"
	help
		Small embeddable Berry scripting language interpreter.

		This package builds a minimal no-MMU friendly command-line
		interpreter for the RP2350 Fruit Jam image. It intentionally
		leaves out readline, dynamic module loading, and the OS module
		for the first bring-up pass.
```

## package/fruitjam-airlift/Config.in
```kconfig
config BR2_PACKAGE_FRUITJAM_AIRLIFT
	bool "Adafruit Fruit Jam AirLift utility"
	help
		Small no-MMU friendly userspace helper for the Fruit Jam ESP32-C6
		AirLift coprocessor. It uses the tiny /dev/airlift-gpio kernel
		helper for board pins, the kernel PL022/spidev SPI path for byte
		transfers, and the NINA command protocol for firmware, MAC, scan,
		join, and status bring-up.
```

## package/fruitjam-netbox/Config.in
```kconfig
config BR2_PACKAGE_FRUITJAM_NETBOX
	bool "fruitjam-netbox"
	help
	  Build a small BusyBox-derived network applet binary for the
	  Fruit Jam no-MMU image. Keeping httpd, nc, ftpd, tftpd,
	  telnetd, wget, ifconfig, and netstat in a separate binary
	  keeps each exec below the RP2350 Linux 256 KiB allocation
	  class.
```

## package/fruitjam-utils/Config.in
```kconfig
config BR2_PACKAGE_FRUITJAM_UTILS
	bool "Adafruit Fruit Jam board utilities"
	help
		Small no-MMU friendly userspace helpers for board-level Fruit Jam
		GPIO diagnostics before full kernel drivers exist. The helpers use
		sysfs GPIO or tiny kernel devices rather than /dev/mem, and can read
		the three onboard buttons, control the active-low red LED, assert the
		shared peripheral reset, enable USB host 5V power, and report/reset
		USB host D+/D- line state for HID bring-up diagnostics.
```

## package/pico2-bootloader/Config.in
```kconfig
config BR2_PACKAGE_PICO2_BOOTLOADER
	bool "RP2350 no-MMU Linux bootloader"
	help
		Custom RP2350 RISC-V bootloader to initialize PSRAM and load Linux.

if BR2_PACKAGE_PICO2_BOOTLOADER

config BR2_PACKAGE_PICO2_BOOTLOADER_UART_INDEX
	int "Bootloader UART index"
	range 0 1
	default 0
	help
		RP2350 UART peripheral used by the bootloader console.

config BR2_PACKAGE_PICO2_BOOTLOADER_UART_TX_PIN
	int "Bootloader UART TX GPIO"
	default 0
	help
		GPIO pin muxed to UART TX before jumping to Linux.

config BR2_PACKAGE_PICO2_BOOTLOADER_UART_RX_PIN
	int "Bootloader UART RX GPIO"
	default 1
	help
		GPIO pin muxed to UART RX before jumping to Linux.

config BR2_PACKAGE_PICO2_BOOTLOADER_PSRAM_CS_PIN
	int "PSRAM XIP CS1 GPIO"
	default 19
	help
		GPIO used for the RP2350 QMI/XIP CS1 PSRAM chip select.

config BR2_PACKAGE_PICO2_BOOTLOADER_LED_PIN
	int "Boot diagnostic LED GPIO"
	default 2
	help
		Optional GPIO toggled when the bootloader starts.

config BR2_PACKAGE_PICO2_BOOTLOADER_LED_ACTIVE_LOW
	bool "Boot diagnostic LED is active low"
	help
		Select this when driving the LED GPIO low turns the LED on.

endif
```
